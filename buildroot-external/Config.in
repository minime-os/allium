## buildroot-external/Config.in
```kconfig
source "$BR2_EXTERNAL_ALLIUM_EXTERNAL_PATH/board/rg35xxsp/Config.in"
source "$BR2_EXTERNAL_ALLIUM_EXTERNAL_PATH/package/allium-support/Config.in"
```

## buildroot-external/configs/allium_rg35xxsp_defconfig
```kconfig
BR2_aarch64=y
BR2_TOOLCHAIN_EXTERNAL=y
BR2_TOOLCHAIN_EXTERNAL_BOOTLIN=y
BR2_TOOLCHAIN_EXTERNAL_BOOTLIN_AARCH64_GLIBC_STABLE=y
BR2_TARGET_LDFLAGS="-fuse-ld=mold"
BR2_DL_DIR="$(TOPDIR)/../dl"
BR2_CCACHE=y
BR2_CCACHE_DIR="$(TOPDIR)/../ccache"
BR2_CCACHE_INITIAL_SETUP="--max-size=30G"
BR2_OPTIMIZE_3=y
BR2_ENABLE_LTO=y
BR2_GLOBAL_PATCH_DIR="$(BR2_EXTERNAL_ALLIUM_EXTERNAL_PATH)/board/rg35xxsp/patches"
BR2_TARGET_GENERIC_HOSTNAME="allium-rg35xxsp"
BR2_ROOTFS_DEVICE_CREATION_DYNAMIC_EUDEV=y
BR2_TARGET_GENERIC_ROOT_PASSWD="root"
BR2_ROOTFS_OVERLAY="$(BR2_EXTERNAL_ALLIUM_EXTERNAL_PATH)/board/rg35xxsp/overlay"
BR2_ROOTFS_POST_BUILD_SCRIPT="$(BR2_EXTERNAL_ALLIUM_EXTERNAL_PATH)/board/rg35xxsp/post-build.sh"
BR2_ROOTFS_POST_IMAGE_SCRIPT="$(BR2_EXTERNAL_ALLIUM_EXTERNAL_PATH)/board/rg35xxsp/post-image.sh"
BR2_ROOTFS_POST_SCRIPT_ARGS="-c $(BR2_EXTERNAL_ALLIUM_EXTERNAL_PATH)/board/rg35xxsp/genimage.cfg"
BR2_LINUX_KERNEL=y
BR2_LINUX_KERNEL_USE_CUSTOM_CONFIG=y
BR2_LINUX_KERNEL_CUSTOM_CONFIG_FILE="$(BR2_EXTERNAL_ALLIUM_EXTERNAL_PATH)/board/rg35xxsp/linux.config"
BR2_LINUX_KERNEL_DTS_SUPPORT=y
BR2_LINUX_KERNEL_INTREE_DTS_NAME="allwinner/sun50i-h700-anbernic-rg35xx-sp"
BR2_PACKAGE_BUSYBOX_CONFIG_FRAGMENT_FILES="$(BR2_EXTERNAL_ALLIUM_EXTERNAL_PATH)/board/rg35xxsp/busybox.config"
BR2_PACKAGE_ALSA_UTILS=y
# BR2_PACKAGE_ALSA_UTILS_ALSAMIXER is not set
BR2_PACKAGE_ALSA_UTILS_AMIXER=y
BR2_PACKAGE_ALSA_UTILS_ALSACTL=y
BR2_PACKAGE_LINUX_FIRMWARE=y
BR2_PACKAGE_LINUX_FIRMWARE_RTL_88XX_BT=y
BR2_PACKAGE_LINUX_FIRMWARE_RTL_RTW88=y
BR2_PACKAGE_WPA_SUPPLICANT=y
BR2_PACKAGE_WPA_SUPPLICANT_CLI=y
BR2_PACKAGE_WPA_SUPPLICANT_NL80211=y
BR2_PACKAGE_BLUEZ5_UTILS=y
# BR2_PACKAGE_BLUEZ5_UTILS_CLIENT is not set
# BR2_PACKAGE_BLUEZ5_UTILS_PLUGINS_NETWORK is not set
BR2_PACKAGE_DROPBEAR=y
# BR2_PACKAGE_DROPBEAR_CLIENT is not set
BR2_PACKAGE_WIRELESS_REGDB=y
BR2_PACKAGE_UTIL_LINUX_BINARIES=y
BR2_PACKAGE_UTIL_LINUX_PARTX=y
BR2_PACKAGE_UTIL_LINUX_RFKILL=y
BR2_PACKAGE_DOSFSTOOLS=y
BR2_PACKAGE_MTOOLS=y
BR2_TARGET_ROOTFS_EROFS=y
BR2_TARGET_ROOTFS_EROFS_LZ4=y
# BR2_TARGET_ROOTFS_TAR is not set
BR2_TARGET_ARM_TRUSTED_FIRMWARE=y
BR2_TARGET_ARM_TRUSTED_FIRMWARE_PLATFORM="sun50i_h616"
BR2_TARGET_UBOOT=y
BR2_TARGET_UBOOT_BOARD_DEFCONFIG="anbernic_rg35xx_h700"
BR2_TARGET_UBOOT_CONFIG_FRAGMENT_FILES="$(BR2_EXTERNAL_ALLIUM_EXTERNAL_PATH)/board/rg35xxsp/uboot.config"
BR2_TARGET_UBOOT_NEEDS_DTC=y
BR2_TARGET_UBOOT_NEEDS_PYLIBFDT=y
BR2_TARGET_UBOOT_NEEDS_OPENSSL=y
BR2_TARGET_UBOOT_NEEDS_ATF_BL31=y
BR2_TARGET_UBOOT_SPL=y
BR2_TARGET_UBOOT_SPL_NAME="u-boot-sunxi-with-spl.bin"
BR2_PACKAGE_HOST_EROFS_UTILS=y
BR2_PACKAGE_HOST_DOSFSTOOLS=y
BR2_PACKAGE_HOST_GENIMAGE=y
BR2_PACKAGE_HOST_MTOOLS=y
BR2_PACKAGE_HOST_UBOOT_TOOLS=y
BR2_PACKAGE_ALLIUM_SP=y
BR2_PACKAGE_FFMPEG_ENCODERS="libx264"
BR2_PACKAGE_FFMPEG_DECODERS=""
BR2_PACKAGE_FFMPEG_MUXERS="mp4"
BR2_PACKAGE_FFMPEG_DEMUXERS=""
BR2_PACKAGE_FFMPEG_PARSERS=""
BR2_PACKAGE_FFMPEG_BSFS=""
BR2_PACKAGE_FFMPEG_PROTOCOLS="file"
BR2_PACKAGE_FFMPEG_FILTERS="scale"
# BR2_PACKAGE_FFMPEG_INDEVS is not set
# BR2_PACKAGE_FFMPEG_OUTDEVS is not set
BR2_PACKAGE_FFMPEG_EXTRACONF="--disable-network --enable-indev=fbdev"
BR2_PACKAGE_UMTPRD=y
```

## buildroot-external/package/allium-support/Config.in
```kconfig
menu "Allium"

config BR2_PACKAGE_ALLIUM_SP
	bool "Allium stack for RG35xxSP"
	depends on BR2_aarch64
	depends on BR2_TOOLCHAIN_USES_GLIBC
	select BR2_PACKAGE_SDL2
	select BR2_PACKAGE_SDL2_IMAGE
	select BR2_PACKAGE_LIBPNG
	select BR2_PACKAGE_SDL2_TTF
	select BR2_PACKAGE_FREETYPE
	select BR2_PACKAGE_ALSA_LIB
	select BR2_PACKAGE_ALSA_UTILS
	select BR2_PACKAGE_ALSA_UTILS_AMIXER
	select BR2_PACKAGE_ALSA_UTILS_ALSACTL
	select BR2_PACKAGE_ZLIB
	select BR2_PACKAGE_LZ4
	select BR2_PACKAGE_DBUS
	select BR2_PACKAGE_WPA_SUPPLICANT
	select BR2_PACKAGE_WPA_SUPPLICANT_NL80211
	select BR2_PACKAGE_READLINE
	select BR2_PACKAGE_BLUEZ5_UTILS
	select BR2_PACKAGE_BLUEZ5_UTILS_TOOLS
	select BR2_PACKAGE_BLUEZ5_UTILS_PLUGINS_AUDIO
	select BR2_PACKAGE_BLUEZ5_UTILS_PLUGINS_HID
	select BR2_PACKAGE_BLUEZ_ALSA
	select BR2_PACKAGE_ALLIUM
	help
	  Enable the Allium package set for Anbernic RG35xxSP.

if BR2_PACKAGE_ALLIUM_SP

source "$BR2_EXTERNAL_ALLIUM_EXTERNAL_PATH/package/bootsplash/Config.in"
source "$BR2_EXTERNAL_ALLIUM_EXTERNAL_PATH/package/allium/Config.in"
source "$BR2_EXTERNAL_ALLIUM_EXTERNAL_PATH/package/remotectl/Config.in"

endif

endmenu
```

## buildroot-external/package/allium/Config.in
```kconfig
config BR2_PACKAGE_ALLIUM
	bool "allium"
	depends on BR2_PACKAGE_ALLIUM_SP
	help
	  Copy the externally built Allium RG35XXSP payload and seed it into
	  /mnt/SDCARD/.allium.

if BR2_PACKAGE_ALLIUM

config BR2_PACKAGE_ALLIUM_PAYLOAD_DIR
	string "Allium payload directory"
	default "$(TOPDIR)/../payload"
	help
	  Directory produced by the top-level SP payload build.

endif
```

## buildroot-external/package/bootsplash/Config.in
```kconfig
config BR2_PACKAGE_BOOTSPLASH
	bool "bootsplash"
	default y
	depends on BR2_PACKAGE_ALLIUM_SP
	help
	  Tiny fbdev splash/overlay utility for early boot and first-boot setup UX.
```

## buildroot-external/package/libretro-common/Config.in
```kconfig
config BR2_PACKAGE_LIBRETRO_COMMON
	bool
	help
	  Build-time libretro API header package pinned to the libretro-common
	  commit aligned with the tracked RetroArch stable release.
```

## buildroot-external/package/libretro-fake08/Config.in
```kconfig
config BR2_PACKAGE_LIBRETRO_FAKE08
	bool "libretro-fake08"
	default y
	depends on BR2_PACKAGE_ALLIUM_SP
	help
	  Upstream MinUI PICO-8 core package for RG35XX-family targets.
```

## buildroot-external/package/libretro-fceumm/Config.in
```kconfig
config BR2_PACKAGE_LIBRETRO_FCEUMM
	bool "libretro-fceumm"
	default y
	depends on BR2_PACKAGE_ALLIUM_SP
	help
	  Base NES core package for Allium (scaffold).
```

## buildroot-external/package/libretro-gambatte/Config.in
```kconfig
config BR2_PACKAGE_LIBRETRO_GAMBATTE
	bool "libretro-gambatte"
	default y
	depends on BR2_PACKAGE_ALLIUM_SP
	help
	  Base GB/GBC core package for Allium (scaffold).
```

## buildroot-external/package/libretro-gpsp/Config.in
```kconfig
config BR2_PACKAGE_LIBRETRO_GPSP
	bool "libretro-gpsp"
	default n
	depends on BR2_PACKAGE_ALLIUM_SP
	help
	  Restored gpSP core package for Allium.
```

## buildroot-external/package/libretro-mednafen-pce-fast/Config.in
```kconfig
config BR2_PACKAGE_LIBRETRO_MEDNAFEN_PCE_FAST
	bool "libretro-mednafen-pce-fast"
	default y
	depends on BR2_PACKAGE_ALLIUM_SP
	help
	  Extra PCE core package for Allium.
```

## buildroot-external/package/libretro-mednafen-supafaust/Config.in
```kconfig
config BR2_PACKAGE_LIBRETRO_MEDNAFEN_SUPAFAUST
	bool "libretro-mednafen-supafaust"
	default y
	depends on BR2_PACKAGE_ALLIUM_SP
	help
	  Extra SUPA core package for Allium.
```

## buildroot-external/package/libretro-mednafen-vb/Config.in
```kconfig
config BR2_PACKAGE_LIBRETRO_MEDNAFEN_VB
	bool "libretro-mednafen-vb"
	default n
	depends on BR2_PACKAGE_ALLIUM_SP
	help
	  Extra Virtual Boy core package for Allium.
```

## buildroot-external/package/libretro-mgba/Config.in
```kconfig
config BR2_PACKAGE_LIBRETRO_MGBA
	bool "libretro-mgba"
	default y
	depends on BR2_PACKAGE_ALLIUM_SP
	help
	  mGBA core package for Allium.
```

## buildroot-external/package/libretro-pcsx-rearmed/Config.in
```kconfig
config BR2_PACKAGE_LIBRETRO_PCSX_REARMED
	bool "libretro-pcsx-rearmed"
	default y
	depends on BR2_PACKAGE_ALLIUM_SP
	help
	  Base PS1 core package for Allium (scaffold).
```

## buildroot-external/package/libretro-picodrive/Config.in
```kconfig
config BR2_PACKAGE_LIBRETRO_PICODRIVE
	bool "libretro-picodrive"
	default y
	depends on BR2_PACKAGE_ALLIUM_SP
	help
	  Base Genesis/MD core package for Allium (scaffold).
```

## buildroot-external/package/libretro-pokemini/Config.in
```kconfig
config BR2_PACKAGE_LIBRETRO_POKEMINI
	bool "libretro-pokemini"
	default n
	depends on BR2_PACKAGE_ALLIUM_SP
	help
	  Extra Pokemon mini core package for Allium.
```

## buildroot-external/package/libretro-race/Config.in
```kconfig
config BR2_PACKAGE_LIBRETRO_RACE
	bool "libretro-race"
	default y
	depends on BR2_PACKAGE_ALLIUM_SP
	help
	  Extra Neo Geo Pocket core package for Allium.
```

## buildroot-external/package/libretro-snes9x2005-plus/Config.in
```kconfig
config BR2_PACKAGE_LIBRETRO_SNES9X2005_PLUS
	bool "libretro-snes9x2005-plus"
	default n
	depends on BR2_PACKAGE_ALLIUM_SP
	help
	  Restored snes9x2005-plus core package for Allium.
```

## buildroot-external/package/minui/Config.in
```kconfig
config BR2_PACKAGE_MINUI
	bool "minui"
	default y
	depends on BR2_PACKAGE_ALLIUM_SP
	select BR2_PACKAGE_SDL2
	select BR2_PACKAGE_SDL2_IMAGE
	select BR2_PACKAGE_LIBPNG
	select BR2_PACKAGE_SDL2_TTF
	select BR2_PACKAGE_FREETYPE
	select BR2_PACKAGE_ALSA_LIB
	select BR2_PACKAGE_ZLIB
	select BR2_PACKAGE_LZ4
	select BR2_PACKAGE_DBUS
	select BR2_PACKAGE_LIBRETRO_COMMON
	help
	  Upstream MinUI frontend package for the RG35xxSP Buildroot image.
```

## buildroot-external/package/remotectl/Config.in
```kconfig
config BR2_PACKAGE_REMOTECTL
	bool "remotectl"
	depends on BR2_PACKAGE_ALLIUM_SP
	select BR2_PACKAGE_FFMPEG
	select BR2_PACKAGE_FFMPEG_FFMPEG
	select BR2_PACKAGE_FFMPEG_GPL
	select BR2_PACKAGE_FFMPEG_SWSCALE
	select BR2_PACKAGE_X264
	help
	  Optional remote UI testing helper for MinUI. Installs a local uinput-backed
	  virtual gamepad daemon and a CLI client (remotectl) for driving
	  MinUI UI navigation over SSH without patching input handling.
```
